## boards/shields/velvet_v3/Kconfig.defconfig
```kconfig
if SHIELD_VELVET_V3_LEFT

config ZMK_KEYBOARD_NAME
    default "velvet-v3"

config ZMK_SPLIT_ROLE_CENTRAL
    default y

endif # SHIELD_VELVET_V3_LEFT

if SHIELD_VELVET_V3_LEFT || SHIELD_VELVET_V3_RIGHT

config ZMK_SPLIT
    default y

endif # SHIELD_VELVET_V3_LEFT || SHIELD_VELVET_V3_RIGHT
```
